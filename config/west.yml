## config/west.yml
```yaml
manifest:
  remotes:
    - name: zmkfirmware
      url-base: https://github.com/zmkfirmware
    - name: DerDreschner
      url-base: https://github.com/DerDreschner
  projects:
    - name: zmk
      remote: DerDreschner
      revision: adv360-z3.2
      import: app/west.yml
  self:
    path: config
```
